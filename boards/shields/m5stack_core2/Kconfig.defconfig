## boards/shields/m5stack_core2/Kconfig.defconfig
```kconfig
# Copyright (c) 2023 Martin Kiepfer <mrmarteng@teleschirm.org>
# SPDX-License-Identifier: Apache-2.0

if SHIELD_M5STACK_CORE2

config SENSOR
	default y

endif # SHIELD_M5STACK_CORE2
```

## dts/bindings/gpio/m5stack-header.yaml
```yaml
# Copyright (c) 2023 Martin Kiepfer
# SPDX-License-Identifier: Apache-2.0

description: |
    GPIO pins exposed on M5Stack headers.


    This binding provides a nexus mapping for 30 pins as depicted below.

        0  GND                  1 ADC0
        2  GND                  3 ADC1
        4  GND                  5 RESET
        6  MOSI                 7 AUD_L/DAC0
        8  MISO                 9 AUD_R/DAC1
        10 SCK                  11 3.3V
        12 RXD0                 13 TXD0
        14 RXD1                 15 TXD1
        16 intSDA               17 intSCL
        18 SDA/IO               19 SCL/IO
        20 GPIO                 21 I2S_WS
        22 I2S_OUT              23 I2S_MCLK
        24 NC                   25 I2S_EN
        26 NC                   27 5V
        28 NC                   29 BAT


compatible: "m5stack-header"

include: [gpio-nexus.yaml, base.yaml]
```
